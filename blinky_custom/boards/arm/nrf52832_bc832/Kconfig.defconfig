## blinky_custom/boards/arm/nrf52832_bc832/Kconfig.defconfig
```kconfig
# Copyright (c) 2024 Nordic Semiconductor ASA
# SPDX-License-Identifier: Apache-2.0

if BOARD_NRF52832_BC832

config BOARD
	default "nrf52832_bc832"

config BT_CTLR
   default BT


endif
```

## led_and_switch/boards/arm/nrf52832_ev_bc832/Kconfig.board
```kconfig
# Copyright (c) 2016 Nordic Semiconductor ASA
# SPDX-License-Identifier: Apache-2.0

config BOARD_NRF52832_EV_BC832
	bool "EV_BC832"
	depends on SOC_NRF52832_CIAA
```

## littleFS/boards/arm/nrf52832_ev_bc832/Kconfig
```kconfig
# nRF52832 EV BC832 board configuration

# Copyright (c) 2016 Nordic Semiconductor ASA
# SPDX-License-Identifier: Apache-2.0

config BOARD_ENABLE_DCDC
	bool "DCDC mode"
	select SOC_DCDC_NRF52X
	default y
	depends on BOARD_NRF52832_EV_BC832

# Additional Configuration Options for MX25L51245G Flash

# MX25L51245G Configuration
config MX25L51245G_SPI_FREQUENCY
    int "MX25L51245G SPI frequency"
    default 8000000
    help
      SPI frequency for MX25L51245G communication in Hz

config MX25L51245G_PAGE_SIZE
    int "MX25L51245G page size"
    default 256
    help
      Page size of MX25L51245G NOR flash in bytes

config MX25L51245G_SECTOR_SIZE
    int "MX25L51245G sector size"
    default 4096
    help
      Sector size of MX25L51245G NOR flash in bytes
```

## littleFS/boards/arm/nrf52832_ev_bc832/Kconfig.defconfig
```kconfig
# Copyright (c) 2016 Nordic Semiconductor ASA
# SPDX-License-Identifier: Apache-2.0

if BOARD_NRF52832_EV_BC832

config BOARD
	default "nrf52832_ev_bc832"

config BT_CTLR
	default BT

endif # BOARD_NRF52832_EV_BC832
```

## system_off/boards/arm/nrf52832_magpie/Kconfig.board
```kconfig
# Copyright (c) 2024 Nordic Semiconductor ASA
# SPDX-License-Identifier: Apache-2.0

config BOARD_NRF52832_MAGPIE
	bool "nrf52832_magpie"
	depends on SOC_NRF52832_CIAA
```

## system_off/boards/arm/nrf52832_magpie/Kconfig.defconfig
```kconfig
# Copyright (c) 2024 Nordic Semiconductor ASA
# SPDX-License-Identifier: Apache-2.0

if BOARD_NRF52832_MAGPIE

config BOARD
	default "nrf52832_magpie"

config BT_CTLR
   default BT


endif
```

## system_off/boards/arm/nrf52832_magpie/nrf52832_magpie_defconfig
```kconfig
# Copyright (c) 2024 Nordic Semiconductor ASA
# SPDX-License-Identifier: Apache-2.0

CONFIG_SOC_SERIES_NRF52X=y
CONFIG_SOC_NRF52832_CIAA=y
CONFIG_BOARD_NRF52832_MAGPIE=y

# Enable MPU
CONFIG_ARM_MPU=y

# Enable hardware stack protection
CONFIG_HW_STACK_PROTECTION=y

# Enable RTT
CONFIG_USE_SEGGER_RTT=y

# enable GPIO
CONFIG_GPIO=y
```
